## esp32_components/console_protocol/Kconfig
```kconfig
menu "Console Protocol"

    choice CONSOLE_REPORT_PORT
        prompt "上报串口"
        default CONSOLE_REPORT_PORT_USB
        help
            选择主机通讯使用的串口。
            UART0 需要压制日志，否则 ESP_LOG 会与协议帧混流导致丢帧。
            USB-Serial-JTAG 使用板载原生 USB 口，可保留 UART0 日志。

        config CONSOLE_REPORT_PORT_UART0
            bool "UART0（默认，需压制日志）"

        config CONSOLE_REPORT_PORT_USB
            bool "USB-Serial-JTAG（保留 UART0 日志）"
    endchoice

    config CONSOLE_BAUD
        int "上报波特率"
        range 115200 3000000
        default 921600
        help
            115200 下画面不可用（320x240 一帧 base64 需 17 秒），
            921600 为实测可用值。

    config CONSOLE_SUPPRESS_LOG
        bool "压制全部日志（避免与协议帧混流）"
        depends on CONSOLE_REPORT_PORT_UART0
        default y

endmenu
```

## esp32_components/display_component/Kconfig
```kconfig
menu "Console Display"

    config CONSOLE_DISPLAY_WIDTH
        int "画面宽度（像素）"
        default 320

    config CONSOLE_DISPLAY_HEIGHT
        int "画面高度（像素）"
        default 240

    config CONSOLE_DISPLAY_MAX_FPS
        int "最大帧率"
        default 20
        help
            受串口带宽限制：921600 下次全屏（75 块）约需 1.7 秒，
            静态界面的实际帧率远高于该值，因为只发变化的块。

endmenu
```

## esp32_components/key_read_driver/Kconfig
```kconfig
menu "Key Read Driver"

    config KEY_READ_ACTIVE_LOW
        bool "按键低电平有效（板载按键通常接地）"
        default y

    config KEY_READ_POLL_MS
        int "轮询间隔（毫秒）"
        default 10

    config KEY_READ_DEBOUNCE_MS
        int "消抖时间（毫秒，仅本地判定用，不改用户工程参数）"
        default 20

    choice KEY_READ_SOURCE
        prompt "按键读取方式"
        default KEY_READ_SOURCE_XL9555
        help
            正点原子 ATK-DNESP32S3 的 KEY0~KEY3 挂在 XL9555 的 P14~P17（不是 GPIO），
            选 GPIO 会全部判成「未配置」。裸 GPIO 板子选 GPIO 模式。
        config KEY_READ_SOURCE_XL9555
            bool "XL9555 IO 扩展（ATK-DNESP32S3 板载按键）"
        config KEY_READ_SOURCE_GPIO
            bool "普通 GPIO"
    endchoice

    config KEY_READ_XL9555_SDA
        int "XL9555 I2C SDA 引脚"
        range 0 48
        default 41
        depends on KEY_READ_SOURCE_XL9555

    config KEY_READ_XL9555_SCL
        int "XL9555 I2C SCL 引脚"
        range 0 48
        default 42
        depends on KEY_READ_SOURCE_XL9555

    config KEY_READ_XL9555_ADDR
        hex "XL9555 I2C 地址"
        default 0x20
        depends on KEY_READ_SOURCE_XL9555

    config KEY_READ_XL9555_BASE_BIT
        int "KEY3 所在位（KEY0 依次 +3）"
        range 0 4
        default 4
        depends on KEY_READ_SOURCE_XL9555

    config KEY_READ_KEY0
        int "KEY0 所在 GPIO（-1 表示不采集）"
        range -1 48
        default -1

    config KEY_READ_KEY1
        int "KEY1 所在 GPIO（-1 表示不采集）"
        range -1 48
        default -1

    config KEY_READ_KEY2
        int "KEY2 所在 GPIO（-1 表示不采集）"
        range -1 48
        default -1

    config KEY_READ_KEY3
        int "KEY3 所在 GPIO（-1 表示不采集）"
        range -1 48
        default -1

    config KEY_READ_RESET
        int "RESET 所在 GPIO（通常接 EN，非 GPIO，默认 -1）"
        range -1 48
        default -1

endmenu
```

## esp32_components/led_read_driver/Kconfig
```kconfig
menu "LED Read Driver"

    config LED_READ_PIN
        int "LED 所在 GPIO（-1 表示不采集）"
        range -1 48
        default 1
        help
            只读该脚电平，不会修改引脚配置。
            正点原子 ATK-DNESP32S3 板载红灯为 GPIO1。

    config LED_READ_ACTIVE_LOW
        bool "低电平点亮（正点原子 ATK-DNESP32S3 板载红灯）"
        default y
        help
            这块板的红灯是灌电流接法：GPIO1 拉低才亮。关掉它则按高电平点亮解释。

    config LED_READ_IDLE_MS
        int "采样间隔（毫秒）"
        default 100

    config LED_READ_WINDOW_US
        int "采样窗口（微秒）"
        default 4000
        help
            窗口内密集采样统计占空比，用于识别 LEDC 调光。

    config LED_READ_PWM_EPS_PCT
        int "静态判定阈值（百分比）"
        default 3
        help
            高电平占比低于该值视为常灭，高于 100 减去该值视为常亮，其余判为 PWM。

endmenu
```
